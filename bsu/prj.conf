## CMakeLists.txt
```
# SPDX-License-Identifier: Apache-2.0

cmake_minimum_required(VERSION 3.20.0)

set(BOARD nrf52840dongle_nrf52840)

find_package(Zephyr REQUIRED HINTS $ENV{ZEPHYR_BASE})
project(p2)

FILE(GLOB app_sources src/*.c)

set(repo ../..)
set(oslib ${repo}/oslib/)
set(bsushell ${oslib}/bsu_drivers/bsu_shell/)
set(bsubt ${oslib}/bsu_drivers/bsu_bluetooth/)

target_include_directories(app PRIVATE ${p2} ${oslib} ${bsushell} ${bsubt})

include_directories(${oslib} ${bsushell} ${bsuhci} ${bsubt})

target_sources(app PRIVATE ${bsushell}/bsu_shell_cmds.c)
target_sources(app PRIVATE ${bsubt}/bsu_bt.c)
target_sources(app PRIVATE ${app_sources})
target_sources(app PRIVATE src/main.c) #necessary
```

## prj.conf
```kconfig
CONFIG_USB_DEVICE_STACK=y
CONFIG_USB_DEVICE_PRODUCT="Zephyr USB console sample"

CONFIG_SERIAL=y
CONFIG_CONSOLE=y
CONFIG_UART_CONSOLE=y
CONFIG_UART_LINE_CTRL=y

CONFIG_GPIO=y

CONFIG_NEWLIB_LIBC=y

#----------------------------------USB SETUP----------------------------------
CONFIG_USB_DEVICE_STACK=y
CONFIG_USB_DEVICE_PRODUCT="Zephyr USB shell sample"
#-----------------------------------------------------------------------------

#--------------------------------USB_OPTIONS----------------------------------
CONFIG_USB_DEVICE_PRODUCT="NRF Dongle Jordan"
CONFIG_USB_DEVICE_MANUFACTURER="Jordan Lim"
CONFIG_USB_DEVICE_VID=0xC553
CONFIG_USB_DEVICE_PID=0x4011
#-----------------------------------------------------------------------------

#-----------------------------SHELL_CONF--------------------------------------
CONFIG_SHELL_BACKEND_SERIAL_CHECK_DTR=y
CONFIG_UART_LINE_CTRL=y
CONFIG_SHELL_BACKEND_SERIAL_INIT_PRIORITY=51
CONFIG_SHELL=y
CONFIG_SHELL_BACKENDS=y
CONFIG_SHELL_BACKEND_SERIAL=y

CONFIG_SHELL_PROMPT_UART="CSSE4011:~$"

CONFIG_SHELL_CMDS=y
CONFIG_SHELL_TAB=y
CONFIG_SHELL_TAB_AUTOCOMPLETION=y
CONFIG_SHELL_VT100_COLORS=y
CONFIG_KERNEL_SHELL=y
#-----------------------------------------------------------------------------

#-----------------------------SHELL_LOGGING-----------------------------------
CONFIG_LOG=y
CONFIG_LOG_PRINTK=y
#-----------------------------------------------------------------------------

#-----------------------------BLUETOOTH_CONF----------------------------------
CONFIG_BT=y
# CONFIG_BT_DEBUG_LOG=n
CONFIG_BT_CENTRAL=y
CONFIG_BT_SMP=y
CONFIG_BT_GATT_CLIENT=y
CONFIG_CBPRINTF_FP_SUPPORT=y
CONFIG_BT_RX_STACK_SIZE=4096

# CONFIG_BT_L2CAP_TX_MTU=65;
# CONFIG_BT_BUF_ACL_RX_SIZE=69;
# CONFIG_BT_CTLR_TX_BUFFER_SIZE=50
# CONFIG_BT_RX_BUF_LEN=50
# CONFIG_BT_CTLR_DATA_LENGTH_MAX=50
```

## src/main.c
```c
/*
 * Copyright (c) 2016 Intel Corporation.
 *
 * SPDX-License-Identifier: Apache-2.0
 */

#include <zephyr/zephyr.h>
#include <zephyr/sys/printk.h>
#include <zephyr/usb/usb_device.h>
#include <zephyr/drivers/uart.h>
#include <zephyr/shell/shell.h>
#include <zephyr/drivers/gpio.h>
#include "bsu_shell_cmds.h"
// #include "bsu_hci.h"
#include "bsu_bt.h"

#define BSU_SHELL_THREAD_PRIORITY 1
#define BSU_SHELL_THREAD_STACK 1024
#define BSU_HCI_THREAD_PRIORITY 2
#define BSU_HCI_THREAD_STACK 1024
#define BSU_BT_THREAD_PRIORITY 3
#define BSU_BT_THREAD_STACK 4096

//Define both threads needed for Prac 3 - Shell and Bluetooth
K_THREAD_DEFINE(bsu_shell_thread_tid, BSU_SHELL_THREAD_STACK, bsu_shell_thread, NULL, NULL, NULL, BSU_SHELL_THREAD_PRIORITY, 0, 0);
K_THREAD_DEFINE(bsu_bt_thread_tid, BSU_BT_THREAD_STACK, bsu_bt_thread, NULL, NULL, NULL, BSU_BT_THREAD_PRIORITY, 0, 0);
```
